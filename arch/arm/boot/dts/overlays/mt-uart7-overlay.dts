/*
 * Copyright (C) 2019 - All Rights Reserved by
 * filename : imx-fire-485r2-overlay.dts
 * brief : Device Tree overlay for EBF6ull rs485 device
 * author : embedfire
 * date : 2019-12-17
 * version : A001
 */

/dts-v1/;
/plugin/;
#include "../imx6ul-pinfunc.h"
#include "dt-bindings/gpio/gpio.h"



/ {
         fragment@0 {
                target=<&uart7>;
                __overlay__ {
                                        pinctrl-names = "default";
                                        pinctrl-0 = <&pinctrl_uart7>;
                                        status = "okay";
                };
         };
        fragment@1 {
                target=<&iomuxc>;
                __overlay__ {
                                        pinctrl_uart7: uart7grp {
                                                fsl,pins = <
                                                        MX6UL_PAD_LCD_DATA16__UART7_DCE_TX     0x1b0b1
                                                        MX6UL_PAD_LCD_DATA17__UART7_DCE_RX     0x1b0b1
                                                >;
                                        };

                };
        };
};

